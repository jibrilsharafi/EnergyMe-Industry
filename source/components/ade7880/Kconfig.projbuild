## source/components/ade7880/Kconfig.projbuild
```kconfig
menu "ADE7880 Energy Measurement Configuration"

    config ENERGY_ADE7880_RESET_PIN
        int "ADE7880 Reset GPIO Pin"
        default 3
        range 0 ENV_GPIO_OUT_RANGE_MAX
        help
            GPIO pin connected to ADE7880 RESET pin.

    config ENERGY_ADE7880_IRQ0_PIN
        int "ADE7880 IRQ0 GPIO Pin"
        default 14
        range 0 ENV_GPIO_OUT_RANGE_MAX
        help
            GPIO pin connected to ADE7880 IRQ0 pin.

    config ENERGY_ADE7880_IRQ1_PIN
        int "ADE7880 IRQ1 GPIO Pin"
        default 13
        range 0 ENV_GPIO_OUT_RANGE_MAX
        help
            GPIO pin connected to ADE7880 IRQ1 pin.
            
    config ENERGY_ADE7880_CS_PIN
        int "ADE7880 CS GPIO Pin"
        default 9
        range 0 ENV_GPIO_OUT_RANGE_MAX
        help
            GPIO pin connected to ADE7880 CS pin.
            
    config ENERGY_ADE7880_MOSI_PIN
        int "ADE7880 MOSI GPIO Pin"
        default 10
        range 0 ENV_GPIO_OUT_RANGE_MAX
        help
            GPIO pin connected to ADE7880 MOSI pin.
            
    config ENERGY_ADE7880_MISO_PIN
        int "ADE7880 MISO GPIO Pin"
        default 11
        range 0 ENV_GPIO_OUT_RANGE_MAX
        help
            GPIO pin connected to ADE7880 MISO pin.
            
    config ENERGY_ADE7880_SCLK_PIN
        int "ADE7880 SCLK GPIO Pin"
        default 12
        range 0 ENV_GPIO_OUT_RANGE_MAX
        help
            GPIO pin connected to ADE7880 SCLK pin.
            
    config ENERGY_ADE7880_SPI_HOST
        int "SPI Host (SPI2_HOST=1, SPI3_HOST=2)"
        default 2
        range 1 2
        help
            SPI host to use for ADE7880 communication.
            
    config ENERGY_ADE7880_SPI_CLOCK_SPEED_HZ
        int "SPI Clock Speed (Hz)"
        default 2500000
        range 100000 2500000
        help
            SPI clock speed for ADE7880 communication.
            
endmenu
```

## source/components/http_service/Kconfig.projbuild
```kconfig
menu "HTTP Server Configuration"

    config HTTP_SERVER_ENABLE_AUTH
        bool "Enable HTTP Digest Authentication"
        default y
        help
            Enable digest authentication for the HTTP server.
            When disabled, all endpoints are publicly accessible.

    config HTTP_SERVER_AUTH_REALM
        string "Authentication Realm"
        default "EnergyMe Industry"
        depends on HTTP_SERVER_ENABLE_AUTH
        help
            Authentication realm for digest authentication.

    config HTTP_SERVER_AUTH_USERNAME
        string "Authentication Username"
        default "admin"
        depends on HTTP_SERVER_ENABLE_AUTH
        help
            Username for digest authentication.

    config HTTP_SERVER_AUTH_PASSWORD
        string "Authentication Password"
        default "admin"
        depends on HTTP_SERVER_ENABLE_AUTH
        help
            Password for digest authentication.

    config HTTP_SERVER_PORT
        int "HTTP Server Port"
        default 80
        range 1 65535
        help
            Port number for the HTTP server.

    config HTTP_SERVER_MAX_URI_HANDLERS
        int "Maximum URI Handlers"
        default 20
        range 5 50
        help
            Maximum number of URI handlers that can be registered with the server.

    config HTTP_SERVER_STACK_SIZE
        int "HTTP Server Stack Size"
        default 8192
        help
            Stack size of the HTTP server task.

    config HTTP_SERVER_TASK_PRIORITY
        int "HTTP Server Task Priority"
        default 5
        range 1 10
        help
            Priority of the HTTP server task.

    config HTTP_SERVER_ENABLE_CORS
        bool "Enable CORS"
        default y
        help
            Enable Cross-Origin Resource Sharing (CORS) support.

    config HTTP_SERVER_ENABLE_LOGS
        bool "Enable Detailed Logs"
        default y
        help
            Enable detailed logging for HTTP server operations.

endmenu
```

## source/components/led_control/Kconfig.projbuild
```kconfig
menu "RGB LED Configuration"

    config RGB_LED_RED_GPIO
        int "RGB LED Red Channel GPIO Number"
        range 0 ENV_GPIO_OUT_RANGE_MAX
        default 8
        help
            GPIO number for RGB LED red channel.

    config RGB_LED_GREEN_GPIO
        int "RGB LED Green Channel GPIO Number"
        range 0 ENV_GPIO_OUT_RANGE_MAX
        default 17
        help
            GPIO number for RGB LED green channel.

    config RGB_LED_BLUE_GPIO
        int "RGB LED Blue Channel GPIO Number"
        range 0 ENV_GPIO_OUT_RANGE_MAX
        default 18
        help
            GPIO number for RGB LED blue channel.
            
    config RGB_LED_TIMER
        int "RGB LED LEDC Timer"
        range 0 3
        default 0
        help
            LEDC Timer to use for RGB LED control.

    config RGB_LED_MODE
        int "RGB LED LEDC Mode"
        range 0 1
        default 0
        help
            LEDC Mode (0 for low speed, 1 for high speed).

    config RGB_LED_DUTY_RES
        int "RGB LED Duty Resolution"
        range 1 20
        default 13
        help
            Set duty resolution for RGB LED control (1-20 bits).

    config RGB_LED_FREQUENCY
        int "RGB LED Frequency (Hz)"
        range 1 40000
        default 5000
        help
            Frequency in Hz for RGB LED control.

endmenu
```

## source/components/log_handler/Kconfig.projbuild
```kconfig
menu "Log Handler Configuration"

    config LOG_UDP_OUTPUT_ENABLE
        bool "Enable UDP log output"
        default y
        help
            Enable sending logs to a UDP server.

    config LOG_UDP_SERVER_IP
        string "UDP Log Server IP"
        default "192.168.2.41"
        depends on LOG_UDP_OUTPUT_ENABLE
        help
            IP address of the UDP server to receive logs.

    config LOG_UDP_SERVER_PORT
        int "UDP Log Server Port"
        range 1024 65535
        default 5000
        depends on LOG_UDP_OUTPUT_ENABLE
        help
            UDP port on which the server is listening for logs.

    config LOG_UDP_BUFFER_SIZE
        int "UDP Log Buffer Size"
        range 256 4096
        default 1024
        depends on LOG_UDP_OUTPUT_ENABLE
        help
            Size of the buffer for UDP log messages.

    config LOG_UDP_LOG_LEVEL
        int "Minimum log level for UDP output"
        range 0 5
        default 3
        depends on LOG_UDP_OUTPUT_ENABLE
        help
            Minimum log level to send over UDP (0=NONE, 1=ERROR, 2=WARN, 3=INFO, 4=DEBUG, 5=VERBOSE).

endmenu
```

## source/components/mux_control/Kconfig.projbuild
```kconfig
menu "Multiplexer Control Configuration"

    config MUX_S0_GPIO
        int "Multiplexer S0 GPIO Number"
        range 0 ENV_GPIO_OUT_RANGE_MAX
        default 35
        help
            GPIO number for multiplexer address line S0.

    config MUX_S1_GPIO
        int "Multiplexer S1 GPIO Number"
        range 0 ENV_GPIO_OUT_RANGE_MAX
        default 36
        help
            GPIO number for multiplexer address line S1.

    config MUX_S2_GPIO
        int "Multiplexer S2 GPIO Number"
        range 0 ENV_GPIO_OUT_RANGE_MAX
        default 37
        help
            GPIO number for multiplexer address line S2.

    config MUX_S3_GPIO
        int "Multiplexer S3 GPIO Number"
        range 0 ENV_GPIO_OUT_RANGE_MAX
        default 38
        help
            GPIO number for multiplexer address line S3.

endmenu
```

## source/main/Kconfig.projbuild
```kconfig
menu "EnergyMe Application Configuration"

    config ENABLE_HTTP_SERVER
        bool "Enable HTTP Server"
        default y
        help
            Enable HTTP server for web interface.

    config WIFI_SSID
        string "WiFi SSID"
        default "EnergyMe"
        help
            SSID (network name) for the example to connect to.

    config WIFI_PASSWORD
        string "WiFi Password"
        default "energy123"
        help
            WiFi password (WPA or WPA2) for the example to use.
            Can be left blank if the network has no security set.

    config MUX_INITIAL_SCAN_ENABLED
        int "Enable initial multiplexer channel scan"
        default 1
        range 0 1
        help
            If enabled (1), the system will scan through all multiplexer channels
            during startup before settling on the final channel.

    config MUX_INITIAL_SCAN_INTERVAL_MS
        int "Time between channel changes during initial scan (ms)"
        default 1000
        range 100 10000
        depends on MUX_INITIAL_SCAN_ENABLED = 1
        help
            Time in milliseconds between channel changes during initial scan.

    config MUX_FINAL_CHANNEL
        int "Final multiplexer channel after scan"
        default 0
        range 0 15
        help
            Channel (0-15) that the multiplexer will stay on after initial scan
            or immediately if scan is disabled.

endmenu
```

## source/sdkconfig.defaults
```kconfig
# Common ESP32 settings
CONFIG_ESP_MAIN_TASK_STACK_SIZE=8192
CONFIG_PARTITION_TABLE_CUSTOM=y

# LED configuration
CONFIG_RGB_LED_RED_GPIO=21
CONFIG_RGB_LED_GREEN_GPIO=22
CONFIG_RGB_LED_BLUE_GPIO=23
CONFIG_RGB_LED_TIMER=0
CONFIG_RGB_LED_MODE=0
CONFIG_RGB_LED_DUTY_RES=10
CONFIG_RGB_LED_FREQUENCY=5000

# Multiplexer default GPIO pins
CONFIG_MUX_S0_GPIO=4
CONFIG_MUX_S1_GPIO=5
CONFIG_MUX_S2_GPIO=6
CONFIG_MUX_S3_GPIO=7

# ADE7880 configuration
CONFIG_ENERGY_ADE7880_RESET_PIN=18
CONFIG_ENERGY_ADE7880_CS_PIN=15
CONFIG_ENERGY_ADE7880_MOSI_PIN=13
CONFIG_ENERGY_ADE7880_MISO_PIN=12
CONFIG_ENERGY_ADE7880_SCLK_PIN=14
CONFIG_ENERGY_ADE7880_SPI_HOST=2
CONFIG_ENERGY_ADE7880_SPI_CLOCK_SPEED_HZ=2500000

# Ethernet configuration
CONFIG_USE_SPI_ETHERNET=y
CONFIG_ETH_SPI_HOST=2
CONFIG_ETH_SPI_MOSI_GPIO=13
CONFIG_ETH_SPI_MISO_GPIO=12
CONFIG_ETH_SPI_SCLK_GPIO=14
CONFIG_ETH_SPI_CLOCK_MHZ=20

# Network settings
CONFIG_WIFI_SSID="EnergyMe"
CONFIG_WIFI_PASSWORD="energy123"
```
